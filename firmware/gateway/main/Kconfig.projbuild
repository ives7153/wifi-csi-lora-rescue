## firmware/gateway/main/Kconfig.projbuild
```kconfig
menu "EchoGuard Gateway Configuration"

    config ECHOGUARD_GATEWAY_SSID
        string "Gateway SoftAP SSID"
        default "EchoGuard-GW-01"
        help
            WPA2-PSK SoftAP name used by this Gateway build. Keep GW-01 as
            the default and override it in a local sdkconfig for GW-02.

    config ECHOGUARD_GATEWAY_ID
        string "Gateway identity reported to the upper computer"
        default "GW-01"
        help
            Stable identity included in gateway_status JSON frames.

    config ECHOGUARD_WIFI_PASSWORD
        string "Gateway SoftAP WPA2 password"
        default "511511511"
        help
            WPA2 password shared with Rescue Nodes. The value is never printed
            to the runtime log.

    config ECHOGUARD_OTA_ENABLED
        bool "Enable Gateway LAN OTA service"
        default n
        help
            Enable the authenticated HTTP OTA service for this Gateway build.
            Keep this disabled for Nodes and Gateway 02.

    config ECHOGUARD_OTA_TOKEN
        string "Gateway LAN OTA token"
        depends on ECHOGUARD_OTA_ENABLED
        default ""
        help
            Local authentication token required by the OTA upload endpoint.
            Set a value of at least 16 characters in an ignored local sdkconfig;
            never commit the token to Git.

endmenu
```

## firmware/gateway/sdkconfig.defaults
```kconfig
CONFIG_IDF_TARGET="esp32s3"
CONFIG_ESPTOOLPY_FLASHSIZE_8MB=y
CONFIG_ESPTOOLPY_FLASHSIZE="8MB"

# Gateway 主控制台使用 UART0 @ 115200，可直接连接 CH340/CP210x USB-UART；
# ESP32-S3 USB Serial/JTAG 同时作为第二输出，兼容带原生 USB 接口的开发板。
CONFIG_ESP_CONSOLE_UART_DEFAULT=y
# CONFIG_ESP_CONSOLE_USB_CDC is not set
# CONFIG_ESP_CONSOLE_USB_SERIAL_JTAG is not set
# CONFIG_ESP_CONSOLE_UART_CUSTOM is not set
# CONFIG_ESP_CONSOLE_NONE is not set
CONFIG_ESP_CONSOLE_SECONDARY_USB_SERIAL_JTAG=y
CONFIG_ESP_CONSOLE_USB_SERIAL_JTAG_ENABLED=y
CONFIG_ESP_CONSOLE_UART_BAUDRATE=115200

# Wi-Fi SoftAP 与 FreeRTOS 基础配置。
CONFIG_ESP_WIFI_ENABLED=y
CONFIG_ESP_WIFI_SOFTAP_SUPPORT=y
CONFIG_FREERTOS_HZ=100
CONFIG_FREERTOS_CHECK_STACKOVERFLOW_CANARY=y

CONFIG_PARTITION_TABLE_CUSTOM=y
CONFIG_PARTITION_TABLE_CUSTOM_FILENAME="../../partitions-8Mib.csv"
CONFIG_PARTITION_TABLE_FILENAME="../../partitions-8Mib.csv"
```

## firmware/node/main/Kconfig.projbuild
```kconfig
menu "Rescue Node Configuration"

    config RESCUE_NODE_ID
        int "Rescue node ID"
        range 1 255
        default 1
        help
            Unique node ID sent in the LoRa payload and Gateway JSON frame.
            Set a different ID before flashing each physical rescue node.

    config ECHOGUARD_PRIMARY_SSID
        string "Primary Gateway SSID"
        default "EchoGuard-GW-01"

    config ECHOGUARD_SECONDARY_SSID
        string "Secondary Gateway SSID"
        default "EchoGuard-GW-02"

    config ECHOGUARD_WIFI_PASSWORD
        string "Gateway WPA2 password"
        default "511511511"
        help
            Shared password for the primary and secondary Gateway SoftAPs.

endmenu
```
